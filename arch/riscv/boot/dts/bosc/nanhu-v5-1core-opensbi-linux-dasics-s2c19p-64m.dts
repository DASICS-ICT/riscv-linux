// SPDX-License-Identifier: (GPL-2.0 OR MIT)
#include "nanhu-v5-1core-opensbi-linux-dasics-s2c19p.dts"

/ {
	model = "bosc,nanhu-v5-1core-opensbi-linux-dasics-s2c19p-64m";

	memory@80000000 {
		reg = <0x0 0x80000000 0x0 0x04000000>;
	};
};
